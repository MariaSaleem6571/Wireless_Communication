#define LED_PIN 6
#define N_BIT 8
//size of synchronous pulse in bit
#define SYNC_SIZE 8
//size of data pulse in byte
#define DATA_SIZE 8

#define BIT_0_DELAY 20
#define BIT_1_DELAY 10
#define STARTING_DELAY 80

//#define BIT_0_DELAY 500
//#define BIT_1_DELAY 250
//#define STARTING_DELAY 1000


String image = "";

int width = 64;
int height = 64;
const unsigned char data[] = {
0x0f, 0x1f, 0x2f, 0x3f, 0x4f, 0x5f, 0x6f, 0x7f, 0x8f, 0x9f, 0xaf, 0xbf, 0xcf, 0xdf, 0xef, 0xff, 
//0xff, 0xff, 0xff, 0xff, 0xff, 0xff, 0xff, 0xff, 0xff, 0xff, 0xfe, 0x00, 0x0f, 0xff, 0xff, 0xff, 
0x0f, 0x1f, 0x2f, 0x3f, 0x4f, 0x5f, 0x6f, 0x7f, 0x8f, 0x9f, 0xaf, 0xbf, 0xcf, 0xdf, 0xef, 0xff, 
//0xff, 0xff, 0xf8, 0x00, 0x07, 0xff, 0xff, 0xff, 0xff, 0xff, 0xf0, 0x00, 0x03, 0xff, 0xff, 0xff, 
0xff, 0xff, 0xf0, 0x00, 0x03, 0xff, 0xff, 0xff, 0xff, 0xff, 0xe0, 0x00, 0x01, 0xff, 0xff, 0xff, 
0xff, 0xff, 0xc0, 0x00, 0x00, 0x7f, 0xff, 0xff, 0xff, 0xff, 0xc0, 0x00, 0x00, 0x3f, 0xff, 0xff, 
0xff, 0xff, 0x80, 0x00, 0x00, 0x1f, 0xff, 0xff, 0xff, 0xff, 0x00, 0x00, 0x00, 0x1f, 0xff, 0xff, 
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0xff, 0xff, 0xff, 0xff, 0xe0, 0x7f, 0xff, 0xff, 0xff, 0xff, 0xff, 0xff, 0xf0, 0xff, 0xff, 0xff
};

//const unsigned char data[] = {
//0x00, 0xff, 0x7f, 0xff, 0xff, 0xff, 0xff, 0x00,
//0x10, 0xfe, 0x3f, 0x5f, 0xf2, 0xff, 0xff, 0x00,
//};


// Store binary data as byte type
byte sync = 0x00;
bool lastStateHigh = false; 

void sendStartPulse() {
  // Keep track of previous state
//  Serial.println("Start sending starting pulse");
  lastStateHigh = !lastStateHigh;
  digitalWrite(LED_PIN, lastStateHigh);
  delay(STARTING_DELAY); // Starting pulse
//  Serial.println("Ending starting pulse");
} 

void transmitBit(byte bitVal) 
{  
  if (bitVal == 0) {
    lastStateHigh = !lastStateHigh; // Toggle the last state for the next bit
    // For '0', for the whole bit period
    digitalWrite(LED_PIN, lastStateHigh);
//    Serial.println(0);
    // Delay for the entire bit period
    delay(BIT_0_DELAY); 
  } else {
    // For '1', change mid-way through the bit period
    // First half
    lastStateHigh = !lastStateHigh; // Toggle the last state for the next bit
    digitalWrite(LED_PIN, lastStateHigh);  
    delay(BIT_1_DELAY);
    // Second half 
    lastStateHigh = !lastStateHigh; // Toggle the last state for the next bit
    digitalWrite(LED_PIN, lastStateHigh); 
//    Serial.println(1);
    delay(BIT_1_DELAY);
  }
}

byte calculateChecksum(int im_idx) 
{
  byte checksum = 0x00;
  for (int i = 0; i < N_BIT; i++) {
    // Extracting each bit and XOR-ing them together
    checksum ^= ((data[im_idx] >> i) & 0x01);
  }
  return checksum;
}

byte calculateTotalChecksum(int start_idx) 
{
  byte checksum = 0x00;
  for (int i = 0; i < DATA_SIZE; i++) 
  {
    checksum |= (calculateChecksum(start_idx + i) << i);
  }
  return checksum;
}

void sendSingleChunk(int start_idx)
{
  // 1 chunk contain 1 starting pulse, 1 byte sync pulse, 8 byte data, 1 byte checksum   
  sendStartPulse();
  // send sync pulse 
//  Serial.println("sync");
  for (int i = 0; i < SYNC_SIZE; i++) 
  {
    transmitBit((sync >> i) & 0x01);
  }
  // send data pulse
  for (int j = 0; j < DATA_SIZE; j++) 
  {
//    Serial.print("data ");
//    Serial.println(j+1);
    for (int i = 0; i < N_BIT; i++) 
    {
      transmitBit((data[start_idx+j] >> i) & 0x01);
    }
  }
//  Serial.println("sum");
  // send check sum  
  byte checksum = calculateTotalChecksum(start_idx);
  for (int i = 0; i < N_BIT; i++) 
  {
    transmitBit((checksum >> i) & 0x01);
  }
}
void showImage()
{
  for(int im_idx=0; im_idx < sizeof(data)/sizeof(byte); im_idx++)
  {
    showOneChar(im_idx);
    if (!((im_idx+1)%(width/8)))
    {     
      Serial.println(image);
      image = "";
    }
  }
}
void showOneChar(int im_idx)
{
  for(int i=0;i<8;i++)
  {
    if ((data[im_idx] >> (7-i)) & 0x01)
      image += " ";
    else
      image += "*";
  }
}
void setup() {
  Serial.begin(9600);
  for (int i=0;i<sizeof(data)/sizeof(byte);i+=N_BIT)
  {
    sendSingleChunk(i);
  }
  lastStateHigh = !lastStateHigh; // Toggle the last state for the next bit
  digitalWrite(LED_PIN, lastStateHigh);  
//  showImage();
}

void loop() {
}
